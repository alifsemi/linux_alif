## Documentation/devicetree/bindings/power/alif,a32-m55-shutdown.yaml
```yaml
# SPDX-License-Identifier: (GPL-2.0-only OR BSD-2-Clause)
%YAML 1.2
---
$id: http://devicetree.org/schemas/power/alif,a32-m55-shutdown.yaml#
$schema: http://devicetree.org/meta-schemas/core.yaml#

title: Alif A32 shutdown mailbox client

maintainers:
  - Pankaj Pandey <pankaj.pandey@alifsemi.com>

description:
  Mailbox client for the request from M55-HE to power off the A32 cluster.
  The channels are the non-secure M55-HE MHU pair 1 transmit and receive
  frames (MHU_A32_M55HE_1_TX / MHU_M55HE_A32_1_RX). The 32-bit doorbell
  values are a software protocol shared with TF-A and the HE sample.
  They are not HWRM register fields.

properties:
  compatible:
    const: alif,a32-m55-shutdown

  mboxes:
    maxItems: 2

  mbox-names:
    items:
      - const: tx
      - const: rx

required:
  - compatible
  - mboxes
  - mbox-names

additionalProperties: false

examples:
  - |
    a32-m55-shutdown {
        compatible = "alif,a32-m55-shutdown";
        mbox-names = "tx", "rx";
        mboxes = <&mbox_m55_he_mhu1_tx 0 0>,
                 <&mbox_m55_he_mhu1_rx 0 0>;
    };
```
