## Documentation/devicetree/bindings/counter/alif,alif-utimer.yaml
```yaml
# SPDX-License-Identifier: (GPL-2.0 OR BSD-2-Clause)
%YAML 1.2
---
$id: http://devicetree.org/schemas/counter/alif,alif-utimer.yaml#
$schema: http://devicetree.org/meta-schemas/core.yaml#

title: Alif Semiconductor UTIMER (Unified Timer) Module

maintainers:
  - Hemanth Kumar <hemanth@alifsemi.com>

description: |
  The Alif UTIMER is a unified timer/counter module with multiple channels,
  each supporting independent start/stop/clear controls and
  interrupt generation.

properties:
  compatible:
    const: alif,alif-utimer

  reg:
    maxItems: 1
    description: |
      Physical base address and size of the UTIMER register set.

  interrupts:
    minItems: 1
    maxItems: 96
    description: |
      List of interrupts, one per timer channel, in ascending order (e.g.,
      Channel 0 = interrupts[0], Channel 1 = interrupts[1], etc.).

  clocks:
    maxItems: 1
    description: |
      AXI clock phandle for the timer module.

  clock-names:
    const: axi_clk

required:
  - compatible
  - reg
  - interrupts
  - clocks
  - clock-names

additionalProperties: false

examples:
  - |
    #include <dt-bindings/interrupt-controller/arm-gic.h>
    #include <dt-bindings/clock/alif,ensemble-clock.h>

    utimer: timer@48000000 {
        compatible = "alif,alif-utimer";
        reg = <0x48000000 0x100000>;
        interrupt-parent = <&gic>;
        interrupts = <GIC_SPI 366 IRQ_TYPE_EDGE_RISING>,
                     <GIC_SPI 367 IRQ_TYPE_EDGE_RISING>,
                     <GIC_SPI 368 IRQ_TYPE_EDGE_RISING>,
                     <GIC_SPI 369 IRQ_TYPE_EDGE_RISING>,
                     <GIC_SPI 370 IRQ_TYPE_EDGE_RISING>,
                     <GIC_SPI 371 IRQ_TYPE_EDGE_RISING>,
                     <GIC_SPI 372 IRQ_TYPE_EDGE_RISING>,
                     <GIC_SPI 373 IRQ_TYPE_EDGE_RISING>,
                     <GIC_SPI 374 IRQ_TYPE_EDGE_RISING>,
                     <GIC_SPI 375 IRQ_TYPE_EDGE_RISING>,
                     <GIC_SPI 376 IRQ_TYPE_EDGE_RISING>,
                     <GIC_SPI 377 IRQ_TYPE_EDGE_RISING>,
                     <GIC_SPI 378 IRQ_TYPE_EDGE_RISING>,
                     <GIC_SPI 379 IRQ_TYPE_EDGE_RISING>,
                     <GIC_SPI 380 IRQ_TYPE_EDGE_RISING>,
                     <GIC_SPI 381 IRQ_TYPE_EDGE_RISING>,
                     <GIC_SPI 382 IRQ_TYPE_EDGE_RISING>,
                     <GIC_SPI 383 IRQ_TYPE_EDGE_RISING>,
                     <GIC_SPI 384 IRQ_TYPE_EDGE_RISING>,
                     <GIC_SPI 385 IRQ_TYPE_EDGE_RISING>,
                     <GIC_SPI 386 IRQ_TYPE_EDGE_RISING>,
                     <GIC_SPI 387 IRQ_TYPE_EDGE_RISING>,
                     <GIC_SPI 388 IRQ_TYPE_EDGE_RISING>,
                     <GIC_SPI 389 IRQ_TYPE_EDGE_RISING>,
                     <GIC_SPI 390 IRQ_TYPE_EDGE_RISING>,
                     <GIC_SPI 391 IRQ_TYPE_EDGE_RISING>,
                     <GIC_SPI 392 IRQ_TYPE_EDGE_RISING>,
                     <GIC_SPI 393 IRQ_TYPE_EDGE_RISING>,
                     <GIC_SPI 394 IRQ_TYPE_EDGE_RISING>,
                     <GIC_SPI 395 IRQ_TYPE_EDGE_RISING>,
                     <GIC_SPI 396 IRQ_TYPE_EDGE_RISING>,
                     <GIC_SPI 397 IRQ_TYPE_EDGE_RISING>,
                     <GIC_SPI 398 IRQ_TYPE_EDGE_RISING>,
                     <GIC_SPI 399 IRQ_TYPE_EDGE_RISING>,
                     <GIC_SPI 400 IRQ_TYPE_EDGE_RISING>,
                     <GIC_SPI 401 IRQ_TYPE_EDGE_RISING>,
                     <GIC_SPI 402 IRQ_TYPE_EDGE_RISING>,
                     <GIC_SPI 403 IRQ_TYPE_EDGE_RISING>,
                     <GIC_SPI 404 IRQ_TYPE_EDGE_RISING>,
                     <GIC_SPI 405 IRQ_TYPE_EDGE_RISING>,
                     <GIC_SPI 406 IRQ_TYPE_EDGE_RISING>,
                     <GIC_SPI 407 IRQ_TYPE_EDGE_RISING>,
                     <GIC_SPI 408 IRQ_TYPE_EDGE_RISING>,
                     <GIC_SPI 409 IRQ_TYPE_EDGE_RISING>,
                     <GIC_SPI 410 IRQ_TYPE_EDGE_RISING>,
                     <GIC_SPI 411 IRQ_TYPE_EDGE_RISING>,
                     <GIC_SPI 412 IRQ_TYPE_EDGE_RISING>,
                     <GIC_SPI 413 IRQ_TYPE_EDGE_RISING>,
                     <GIC_SPI 414 IRQ_TYPE_EDGE_RISING>,
                     <GIC_SPI 415 IRQ_TYPE_EDGE_RISING>,
                     <GIC_SPI 416 IRQ_TYPE_EDGE_RISING>,
                     <GIC_SPI 417 IRQ_TYPE_EDGE_RISING>,
                     <GIC_SPI 418 IRQ_TYPE_EDGE_RISING>,
                     <GIC_SPI 419 IRQ_TYPE_EDGE_RISING>,
                     <GIC_SPI 420 IRQ_TYPE_EDGE_RISING>,
                     <GIC_SPI 421 IRQ_TYPE_EDGE_RISING>,
                     <GIC_SPI 422 IRQ_TYPE_EDGE_RISING>,
                     <GIC_SPI 423 IRQ_TYPE_EDGE_RISING>,
                     <GIC_SPI 424 IRQ_TYPE_EDGE_RISING>,
                     <GIC_SPI 425 IRQ_TYPE_EDGE_RISING>,
                     <GIC_SPI 426 IRQ_TYPE_EDGE_RISING>,
                     <GIC_SPI 427 IRQ_TYPE_EDGE_RISING>,
                     <GIC_SPI 428 IRQ_TYPE_EDGE_RISING>,
                     <GIC_SPI 429 IRQ_TYPE_EDGE_RISING>,
                     <GIC_SPI 430 IRQ_TYPE_EDGE_RISING>,
                     <GIC_SPI 431 IRQ_TYPE_EDGE_RISING>,
                     <GIC_SPI 432 IRQ_TYPE_EDGE_RISING>,
                     <GIC_SPI 433 IRQ_TYPE_EDGE_RISING>,
                     <GIC_SPI 434 IRQ_TYPE_EDGE_RISING>,
                     <GIC_SPI 435 IRQ_TYPE_EDGE_RISING>,
                     <GIC_SPI 436 IRQ_TYPE_EDGE_RISING>,
                     <GIC_SPI 437 IRQ_TYPE_EDGE_RISING>,
                     <GIC_SPI 438 IRQ_TYPE_EDGE_RISING>,
                     <GIC_SPI 439 IRQ_TYPE_EDGE_RISING>,
                     <GIC_SPI 440 IRQ_TYPE_EDGE_RISING>,
                     <GIC_SPI 441 IRQ_TYPE_EDGE_RISING>,
                     <GIC_SPI 442 IRQ_TYPE_EDGE_RISING>,
                     <GIC_SPI 443 IRQ_TYPE_EDGE_RISING>,
                     <GIC_SPI 444 IRQ_TYPE_EDGE_RISING>,
                     <GIC_SPI 445 IRQ_TYPE_EDGE_RISING>,
                     <GIC_SPI 446 IRQ_TYPE_EDGE_RISING>,
                     <GIC_SPI 447 IRQ_TYPE_EDGE_RISING>,
                     <GIC_SPI 448 IRQ_TYPE_EDGE_RISING>,
                     <GIC_SPI 449 IRQ_TYPE_EDGE_RISING>,
                     <GIC_SPI 450 IRQ_TYPE_EDGE_RISING>,
                     <GIC_SPI 451 IRQ_TYPE_EDGE_RISING>,
                     <GIC_SPI 452 IRQ_TYPE_EDGE_RISING>,
                     <GIC_SPI 453 IRQ_TYPE_EDGE_RISING>,
                     <GIC_SPI 454 IRQ_TYPE_EDGE_RISING>,
                     <GIC_SPI 455 IRQ_TYPE_EDGE_RISING>,
                     <GIC_SPI 456 IRQ_TYPE_EDGE_RISING>,
                     <GIC_SPI 457 IRQ_TYPE_EDGE_RISING>,
                     <GIC_SPI 458 IRQ_TYPE_EDGE_RISING>,
                     <GIC_SPI 459 IRQ_TYPE_EDGE_RISING>,
                     <GIC_SPI 460 IRQ_TYPE_EDGE_RISING>,
                     <GIC_SPI 461 IRQ_TYPE_EDGE_RISING>;
        clocks = <&psclks ENSEMBLE_SYST_ACLK>;
        clock-names = "axi_clk";
        status = "okay";
    };
```

## Documentation/devicetree/bindings/display/tes,cdc-2.1.yaml
```yaml
# SPDX-License-Identifier: (GPL-2.0-only OR BSD-2-Clause)
%YAML 1.2
---
$id: http://devicetree.org/schemas/display/tes,cdc-2.1.yaml#
$schema: http://devicetree.org/meta-schemas/core.yaml#

title: TES Electronic Solutions CDC200 Display Controller

maintainers:
  - Yogender Kumar Arya <yogender.kumar@alifsemi.com>

description:
  The TES CDC200 is a display controller used on Alif Ensemble SoCs. It
  reads framebuffer data and drives LCD, LVDS or DSI encoder outputs.

properties:
  compatible:
    const: tes,cdc-2.1

  reg:
    maxItems: 1

  interrupts:
    minItems: 1
    maxItems: 5
    description: |
      Following interrupts support has been added:
      scanline (322), FIFO underrun warn (324), FIFO underrun (326),
      bus error (328) and shadow reload (330). The driver must request
      every listed interrupt; IRQ_STATUS bits are only set for the SPI
      that fired.

  interrupt-names:
    minItems: 1
    items:
      - const: scanline
      - const: fifo-warn
      - const: fifo-underrun
      - const: bus-error
      - const: reload

  clocks:
    items:
      - description: APB interface clock
      - description: Pixel clock

  clock-names:
    items:
      - const: apb_pclk
      - const: pix_clk

  memory-region:
    maxItems: 1
    description:
      Phandle to reserved memory used for the framebuffer. If omitted the
      framebuffer may be located anywhere in memory.

  port:
    $ref: /schemas/graph.yaml#/properties/port
    description:
      Single RGB output when the controller has only one connection.

  ports:
    $ref: /schemas/graph.yaml#/properties/ports
    description: Output ports of the display controller.

    properties:
      port@0:
        $ref: /schemas/graph.yaml#/$defs/port-base
        unevaluatedProperties: false
        description: Parallel RGB output to a panel or encoder.

        properties:
          endpoint:
            $ref: /schemas/media/video-interfaces.yaml#
            unevaluatedProperties: false

            properties:
              bus-width:
                $ref: /schemas/types.yaml#/definitions/uint32
                enum: [16, 18, 24]

required:
  - compatible
  - reg
  - interrupts
  - clocks
  - clock-names

additionalProperties: false

examples:
  - |
    #include <dt-bindings/interrupt-controller/arm-gic.h>
    display-controller@49031000 {
        compatible = "tes,cdc-2.1";
        reg = <0x49031000 0x1000>;
        interrupts = <GIC_SPI 322 IRQ_TYPE_LEVEL_HIGH>,
                     <GIC_SPI 324 IRQ_TYPE_LEVEL_HIGH>,
                     <GIC_SPI 326 IRQ_TYPE_LEVEL_HIGH>,
                     <GIC_SPI 328 IRQ_TYPE_LEVEL_HIGH>,
                     <GIC_SPI 330 IRQ_TYPE_LEVEL_HIGH>;
        interrupt-names = "scanline", "fifo-warn", "fifo-underrun",
                          "bus-error", "reload";
        clocks = <&psclks 0>, <&psclks 1>;
        clock-names = "apb_pclk", "pix_clk";

        ports {
            #address-cells = <1>;
            #size-cells = <0>;

            port@0 {
                reg = <0>;
                endpoint {
                    remote-endpoint = <&panel_in>;
                    bus-width = <24>;
                };
            };
        };
    };
...
```

## Documentation/devicetree/bindings/display/tes,dswz.yaml
```yaml
# SPDX-License-Identifier: (GPL-2.0-only OR BSD-2-Clause)
%YAML 1.2
---
$id: http://devicetree.org/schemas/display/tes,dswz.yaml#
$schema: http://devicetree.org/meta-schemas/core.yaml#

title: TES Electronic Solutions CDC framebuffer deswizzler

maintainers:
  - Yogender Kumar Arya <yogender.kumar@alifsemi.com>

description:
  Optional companion block for the TES CDC200 display controller that
  converts swizzled framebuffer data to linear scanout order.

properties:
  compatible:
    const: tes,dswz

  reg:
    maxItems: 1

  interrupts:
    maxItems: 1

required:
  - compatible
  - reg
  - interrupts

additionalProperties: false

examples:
  - |
    deswizzler@0 {
        compatible = "tes,dswz";
        reg = <0x0 0x1000>;
        interrupts = <0>;
    };
...
```

## Documentation/devicetree/bindings/media/alif,ensemble-cpi.yaml
```yaml
# SPDX-License-Identifier: (GPL-2.0-only OR BSD-2-Clause)
%YAML 1.2
---
$id: http://devicetree.org/schemas/media/alif,ensemble-cpi.yaml#
$schema: http://devicetree.org/meta-schemas/core.yaml#

title: Alif Ensemble Camera Parallel Interface (CPI)

maintainers:
  - Yogender Kumar Arya <yogender.kumar@alifsemi.com>

properties:
  compatible:
    enum:
      - alif,ensemble-cpi
      - alif,ensemble-cpi2

  reg:
    maxItems: 1

  interrupts:
    maxItems: 1

  clocks:
    minItems: 2
    maxItems: 2

  clock-names:
    items:
      - const: apb_clk
      - const: pix_clk

  memory-region:
    description:
      Phandle to a reserved-memory region used for CPI frame buffers.

  ports:
    $ref: /schemas/graph.yaml#/properties/ports
    properties:
      port@0:
        $ref: /schemas/graph.yaml#/$defs/port-base
        unevaluatedProperties: false
        description: Input port receiving from the CSI-2 controller.
        properties:
          endpoint:
            $ref: video-interfaces.yaml#
            unevaluatedProperties: false
            properties:
              bus-type:
                const: 4
              remote-endpoint: true

      port@1:
        $ref: /schemas/graph.yaml#/$defs/port-base
        unevaluatedProperties: false
        description: Output port to the next processing stage.
        properties:
          endpoint:
            $ref: video-interfaces.yaml#
            unevaluatedProperties: false
            properties:
              bus-type:
                const: 4
              remote-endpoint: true

    required:
      - port@0
      - port@1

required:
  - compatible
  - reg
  - interrupts
  - clocks
  - clock-names
  - ports

additionalProperties: false

examples:
  - |
    #include <dt-bindings/interrupt-controller/arm-gic.h>

    camera-controller@49030000 {
        compatible = "alif,ensemble-cpi2";
        reg = <0x49030000 0x1000>;
        interrupt-parent = <&gic>;
        interrupts = <GIC_SPI 334 IRQ_TYPE_LEVEL_HIGH>;
        clocks = <&psclks 104>, <&psclks 61>;
        clock-names = "apb_clk", "pix_clk";
        memory-region = <&cpi_buf>;

        ports {
            #address-cells = <1>;
            #size-cells = <0>;

            port@0 {
                reg = <0>;
                endpoint {
                    bus-type = <4>;
                    remote-endpoint = <&csi_out>;
                };
            };

            port@1 {
                reg = <1>;
                endpoint {
                    bus-type = <4>;
                    remote-endpoint = <&cpi_out>;
                };
            };
        };
    };
```
