## Documentation/devicetree/bindings/rpmsg/alif,mhu-client.yaml
```yaml
# SPDX-License-Identifier: (GPL-2.0 OR BSD-2-Clause)
---
$id: http://devicetree.org/schemas/rpmsg/alif,mhu-client.yaml#
$schema: http://devicetree.org/meta-schemas/core.yaml#

title: ARM MHUv2 RPMSG mailbox Client
description: ARM MHUv2 RPMSG mailbox Client

maintainers:
  - Hemanth Kumar <hemanth@alifsemi.com>

properties:
  compatible:
    enum:
      - arm,client

  mboxes:
    description: |
      List of phandles to mailbox channels used for receiving and
      transmitting data from and to the hardware UART.
    minItems: 12
    maxItems: 12

  mbox-names:
    items:
      - const: txdb0
      - const: txdb1
      - const: rxdb0
      - const: rxdb1
      - const: txdb2
      - const: txdb3
      - const: rxdb2
      - const: rxdb3
      - const: txdb4
      - const: txdb5
      - const: rxdb4
      - const: rxdb5

required:
  - compatible
  - mbox-names
  - mboxes

additionalProperties: false

examples:
  - |
    client {
        compatible = "arm,client";
        mbox-names = "txdb0", "txdb1",
                     "rxdb0", "rxdb1",
                     "txdb2", "txdb3",
                     "rxdb2", "rxdb3",
                     "txdb4", "txdb5",
                     "rxdb4", "rxdb5";
        mboxes = <&mbox_m55_hp_mhu0_tx 0 0>,
                 <&mbox_m55_hp_mhu1_tx 0 0>,
                 <&mbox_m55_hp_mhu0_rx 0 0>,
                 <&mbox_m55_hp_mhu1_rx 0 0>,
                 <&mbox_m55_he_mhu0_tx 0 0>,
                 <&mbox_m55_he_mhu1_tx 0 0>,
                 <&mbox_m55_he_mhu0_rx 0 0>,
                 <&mbox_m55_he_mhu1_rx 0 0>,
                 <&mbox_se_mhu0_tx 0 0>,
                 <&mbox_se_mhu1_tx 0 0>,
                 <&mbox_se_mhu0_rx 0 0>,
                 <&mbox_se_mhu1_rx 0 0>;
    };
```

## Documentation/devicetree/bindings/usb/alif,ensemble-usb3.yaml
```yaml
# SPDX-License-Identifier: (GPL-2.0-only OR BSD-2-Clause)
%YAML 1.2
---
$id: http://devicetree.org/schemas/usb/alif,ensemble-usb3.yaml#
$schema: http://devicetree.org/meta-schemas/core.yaml#

title: Alif Ensemble DWC3 USB Controller

maintainers:
  - Hemanth Kumar <hemanth@alifsemi.com>

properties:
  compatible:
    enum:
      - alif,ensemble-usb3

  "#address-cells":
    const: 1

  "#size-cells":
    const: 1

  ranges: true

  status:
    enum:
      - okay
      - disabled

  clock-names:
    items:
      - const: usb_clk
      - const: dwc_clk

  clocks:
    items:
      - description: Handle to ENSEMBLE_USB_CLK
      - description: Handle to ENSEMBLE_DWC_USB_CLK

patternProperties:
  "^usb@.*$":
    type: object
    description: |
      USB Dual Role Device node for the DWC3 controller.
    additionalProperties: false
    properties:
      compatible:
        items:
          - const: snps
          - const: snps,dwc3

      reg:
        items:
          - description: Base address and size of the DWC3 controller.

      interrupts:
        maxItems: 1
        description: Interrupt specifier for the DWC3 controller.

      phy:
        description: Handle to the PHY used by the DWC3 controller.

      phys:
        description: Handle to the PHY used by the DWC3 controller.

      phy-names:
        const: usb2_phy

      dr_mode:
        enum:
          - host
          - peripheral
          - otg

      snps,hsphy_interface:
        const: utmi

      phy_type:
        const: utmi_wide

      maximum-speed:
        enum:
          - high-speed
          - super-speed
          - super-speed-plus

      snps,dis_u3_susphy_quirk:
        type: boolean
        description: Disable USB 3.0 suspend PHY quirk.

      snps,dis_u2_susphy_quirk:
        type: boolean
        description: Disable USB 2.0 suspend PHY quirk.

      snps,incr-burst-type-adjustment:
        minItems: 1
        maxItems: 4
        items:
          type: integer
        description: |
          Adjustment of burst types: supported values are 1, 4, 8, 16.

      snps,quirk-frame-length-adjustment:
        $ref: /schemas/types.yaml#/definitions/uint32
        description: Frame length adjustment quirk value.

      snps,usb2-lpm-disable:
        type: boolean
        description: Disable USB2 LPM support.

required:
  - compatible
  - "#address-cells"
  - "#size-cells"
  - ranges
  - status
  - clock-names
  - clocks

additionalProperties: false

examples:
  - |
    #include <dt-bindings/interrupt-controller/irq.h>
    #include <dt-bindings/interrupt-controller/arm-gic.h>
    #include <dt-bindings/clock/alif,ensemble-clock.h>

    hsusb: dwc3-drd {
        compatible = "alif,ensemble-usb3";
        #address-cells = <1>;
        #size-cells = <1>;
        ranges;
        status = "disabled";
        clock-names = "usb_clk", "dwc_clk";
        clocks = <&psclks ENSEMBLE_USB_CLK>, <&psclks ENSEMBLE_DWC_USB_CLK>;

        dwc3: usb@48200000 {
            compatible = "snps", "snps,dwc3";
            reg = <0x48200000 0x100000>;
            interrupts = <GIC_SPI 26 IRQ_TYPE_LEVEL_HIGH>;
            phy = <&psclks ENSEMBLE_USB_CLK>;
            phy-names = "usb2_phy";
            dr_mode = "peripheral";
            snps,hsphy_interface = "utmi";
            phy_type = "utmi_wide";
            maximum-speed = "high-speed";
            snps,dis_u3_susphy_quirk;
            snps,dis_u2_susphy_quirk;
            snps,incr-burst-type-adjustment = <1>, <4>, <8>, <16>;
            snps,quirk-frame-length-adjustment = <0x20>;
            snps,usb2-lpm-disable;
        };
    };
```

## arch/arm/configs/devkit_e8_defconfig
```kconfig
# CONFIG_LOCALVERSION_AUTO is not set
# CONFIG_CROSS_MEMORY_ATTACH is not set
CONFIG_PREEMPT=y
CONFIG_LOG_BUF_SHIFT=13
# CONFIG_INITRAMFS_PRESERVE_MTIME is not set
CONFIG_CC_OPTIMIZE_FOR_SIZE=y
CONFIG_EXPERT=y
# CONFIG_ARM_PATCH_PHYS_VIRT is not set
CONFIG_PHYS_OFFSET=0x2000000
CONFIG_ARM_MULTI_ARMV8A=y
CONFIG_ARCH_ENSEMBLE=y
CONFIG_SMP=y
# CONFIG_SMP_ON_UP is not set
CONFIG_HAVE_ARM_ARCH_TIMER=y
CONFIG_NR_CPUS=2
CONFIG_ARM_PSCI=y
CONFIG_THUMB2_KERNEL=y
# CONFIG_ARM_PATCH_IDIV is not set
# CONFIG_ARM_PAN is not set
# CONFIG_ATAGS is not set
CONFIG_CMDLINE="console=ttyS1"
CONFIG_XIP_KERNEL=y
CONFIG_XIP_PHYS_ADDR=0x80020000
CONFIG_XIP_DEFLATED_DATA=y
CONFIG_VFP=y
CONFIG_NEON=y
CONFIG_KERNEL_MODE_NEON=y
# CONFIG_SUSPEND is not set
# CONFIG_SECCOMP is not set
# CONFIG_STACKPROTECTOR is not set
CONFIG_COMPAT_32BIT_TIME=y
# CONFIG_VMAP_STACK is not set
# CONFIG_GCC_PLUGINS is not set
# CONFIG_CORE_DUMP_DEFAULT_ELF_HEADERS is not set
CONFIG_BINFMT_SCRIPT=y
# CONFIG_SWAP is not set
# CONFIG_COMPAT_BRK is not set
CONFIG_SPARSEMEM_MANUAL=y
# CONFIG_BOUNCE is not set
CONFIG_NET=y
CONFIG_UNIX=y
CONFIG_DEVTMPFS=y
CONFIG_MTD=y
CONFIG_MTD_CMDLINE_PARTS=y
CONFIG_MTD_BLOCK=y
CONFIG_MTD_ROM=y
CONFIG_MTD_PHYSMAP=y
CONFIG_MTD_PHYSMAP_COMPAT=y
CONFIG_MTD_PHYSMAP_START=0x80380000
CONFIG_MTD_PHYSMAP_LEN=0x200000
CONFIG_MTD_PHYSMAP_BANKWIDTH=4
CONFIG_MTD_PHYSMAP_OF=y
CONFIG_MTD_PLATRAM=y
CONFIG_BLK_DEV=y
CONFIG_INPUT_FF_MEMLESS=y
# CONFIG_INPUT_KEYBOARD is not set
# CONFIG_INPUT_MOUSE is not set
# CONFIG_LEGACY_PTYS is not set
CONFIG_SERIAL_8250=y
CONFIG_SERIAL_8250_CONSOLE=y
CONFIG_SERIAL_8250_NR_UARTS=8
CONFIG_SERIAL_8250_RUNTIME_UARTS=8
CONFIG_SERIAL_8250_DW=y
CONFIG_GPIO_DWAPB=y
# CONFIG_HWMON is not set
# CONFIG_HID_SUPPORT is not set
# CONFIG_USB_SUPPORT is not set
# CONFIG_VIRTIO_MENU is not set
# CONFIG_VHOST_MENU is not set
CONFIG_MAILBOX=y
CONFIG_ARM_MHU_V2=y
# CONFIG_IOMMU_SUPPORT is not set
# CONFIG_NVMEM is not set
CONFIG_DNOTIFY=y
CONFIG_INOTIFY_USER=y
CONFIG_PROC_SYSCTL=y
CONFIG_RPMSG_CHAR=y
CONFIG_RPMSG_ARM=y
CONFIG_RPMSG_ARM_MHU_CLIENT=y
CONFIG_RPMSG_CTRL=y
CONFIG_RPMSG_NS=y
# CONFIG_PROC_PAGE_MONITOR is not set
CONFIG_TMPFS=y
CONFIG_CRAMFS=y
CONFIG_CRAMFS_MTD=y
CONFIG_LSM="lockdown,yama,loadpin,safesetid,integrity"
# CONFIG_SYMBOLIC_ERRNAME is not set
# CONFIG_DEBUG_BUGVERBOSE is not set
# CONFIG_DEBUG_MISC is not set
# CONFIG_FTRACE is not set
# CONFIG_RUNTIME_TESTING_MENU is not set
CONFIG_FILE_LOCKING=y
CONFIG_NLS=y
CONFIG_UNICODE=y
CONFIG_NAMESPACES=y
# CONFIG_SYSFS is not set
# CONFIG_KALLSYMS is not set
# CONFIG_SYSFS_SYSCALL is not set
# CONFIG_CACHESTAT_SYSCALL is not set
CONFIG_FAT_FS=y
CONFIG_VFAT_FS=y
CONFIG_FAT_DEFAULT_CODEPAGE=437
CONFIG_FAT_DEFAULT_IOCHARSET="iso8859-1"
CONFIG_NLS_CODEPAGE_437=y
CONFIG_NLS_ISO8859_1=y
CONFIG_FAT_DEFAULT_UTF8=y
# CONFIG_WIRELESS is not set
# CONFIG_WLAN is not set
```

## drivers/gpu/drm/tes/Kconfig
```kconfig
# SPDX-License-Identifier: GPL-2.0
config DRM_TES_CDC
	tristate "DRM Support for TES CDC200"
	depends on DRM && OF
	depends on ARM
	depends on ARCH_ENSEMBLE || COMPILE_TEST
	select DRM_KMS_HELPER
	select DRM_GEM_DMA_HELPER
	select VIDEOMODE_HELPERS
	help
	  DRM/KMS driver for the TES Electronic Solutions CDC200 display
	  controller found on Alif Ensemble SoCs. This provides CRTC, plane
	  and encoder support for LCD, LVDS and related display outputs.

	  If M is selected the module will be called cdc.
```

## drivers/phy/synopsys/Kconfig
```kconfig
config PHY_SYNOPSYS_DPHY_RX
	tristate "Synopsys D-PHY Rx Support"
	depends on HAS_IOMEM && OF
	select GENERIC_PHY
	select GENERIC_PHY_MIPI_DPHY
	help
	  Enable support for the Synopsys DesignWare MIPI D-PHY in
	  receive (RX) configuration. This PHY is used with MIPI CSI-2
	  camera interfaces on SoCs such as Alif Ensemble.

	  To compile this driver as a module, choose M here: the module
	  will be called snps-dphy-rx.
```

## drivers/rpmsg/Kconfig
```kconfig
# SPDX-License-Identifier: GPL-2.0

menu "Rpmsg drivers"

# RPMSG always gets selected by whoever wants it
config RPMSG
	tristate

config RPMSG_CHAR
	tristate "RPMSG device interface"
	depends on RPMSG
	depends on NET
	help
	  Say Y here to export rpmsg endpoints as device files, usually found
	  in /dev. They make it possible for user-space programs to send and
	  receive rpmsg packets.

config RPMSG_ARM
        tristate "ARM RPMSG driver"
        select RPMSG
        depends on HAS_IOMEM
        depends on MAILBOX
        help
          Enables RPMSG client support for ARM Message Handling Unit (MHUv2.1)
          based systems. This driver implements inter-processor communication
          between application processors and remote processors using ARM's
          MHUv2.1 hardware as the physical transport medium. The implementation
          leverages the mailbox subsystem for message passing.

          Select Y here to enable IPC support for ARM platforms using MHUv2.1
          hardware blocks. Requires IO memory management and mailbox subsystem
          support.

config RPMSG_ARM_MHU_CLIENT
	tristate "ARM MHU0 HE client (rxdb2/txdb2 M55_PERIPH_OFF_REQ)"
	depends on RPMSG_ARM
	depends on MAILBOX
	default y
	help
	  Claim the same arm,client endpoints as pthread_m55_he_mhu0_inloop
	  (rxdb2 / txdb2 -> M55-HE MHU0) and ACK M55_PERIPH_OFF_REQ in IRQ
	  context. The ACK is sent without sleeping, then the A32 shutdown
	  guard starts orderly_poweroff(). Leaves rpmsg_arm_mailbox.c
	  unchanged.

config RPMSG_CTRL
	tristate "RPMSG control interface"
	depends on RPMSG && ( RPMSG_CHAR || RPMSG_CHAR=n )
	help
	  Say Y here to enable the support of the /dev/rpmsg_ctrlX API. This API
	  allows user-space programs to create endpoints with specific service name,
	  source and destination addresses.

config RPMSG_NS
	tristate "RPMSG name service announcement"
	depends on RPMSG
	help
	  Say Y here to enable the support of the name service announcement
	  channel that probes the associated RPMsg device on remote endpoint
	  service announcement.

config RPMSG_MTK_SCP
	tristate "MediaTek SCP"
	depends on MTK_SCP
	select RPMSG
	help
	  Say y here to enable support providing communication channels to
	  remote processors in MediaTek platforms.
	  This use IPI and IPC to communicate with remote processors.

config RPMSG_QCOM_GLINK
	tristate
	select RPMSG

config RPMSG_QCOM_GLINK_RPM
	tristate "Qualcomm RPM Glink driver"
	select RPMSG_QCOM_GLINK
	depends on HAS_IOMEM
	depends on MAILBOX
	help
	  Say y here to enable support for the GLINK RPM communication driver,
	  which serves as a channel for communication with the RPM in GLINK
	  enabled systems.

config RPMSG_QCOM_GLINK_SMEM
	tristate "Qualcomm SMEM Glink driver"
	select RPMSG_QCOM_GLINK
	depends on MAILBOX
	depends on QCOM_SMEM
	help
	  Say y here to enable support for the GLINK SMEM communication driver,
	  which provides support for using the GLINK communication protocol
	  over SMEM.

config RPMSG_QCOM_SMD
	tristate "Qualcomm Shared Memory Driver (SMD)"
	depends on MAILBOX
	depends on QCOM_SMEM
	select RPMSG
	help
	  Say y here to enable support for the Qualcomm Shared Memory Driver
	  providing communication channels to remote processors in Qualcomm
	  platforms.

config RPMSG_VIRTIO
	tristate "Virtio RPMSG bus driver"
	depends on HAS_DMA
	select RPMSG
	select RPMSG_NS
	select VIRTIO

endmenu
```
