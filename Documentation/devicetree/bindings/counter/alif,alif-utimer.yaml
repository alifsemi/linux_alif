## Documentation/devicetree/bindings/media/i2c/onnn,arx3a0.yaml
```yaml
# SPDX-License-Identifier: (GPL-2.0-only OR BSD-2-Clause)
%YAML 1.2
---
$id: http://devicetree.org/schemas/media/i2c/onnn,arx3a0.yaml#
$schema: http://devicetree.org/meta-schemas/core.yaml#

title: ON Semiconductor / Apta ARX3A0 CMOS Image Sensor

maintainers:
  - Yogender Kumar Arya <yogender.kumar@alifsemi.com>

description: |-
  The ARX3A0 is a raw CMOS image sensor with a MIPI CSI-2 interface and
  an I2C-compatible control bus.

properties:
  compatible:
    const: onnn,arx3a0

  reg:
    maxItems: 1

  clocks:
    maxItems: 1

  clock-names:
    const: extclk

  reset-gpios:
    maxItems: 1
    description: GPIO connected to the sensor reset pin, usually active low

  power-gpios:
    maxItems: 1
    description: GPIO connected to the sensor power enable pin

  vdd_io-supply:
    description: I/O (1.8V) supply

  vdd-supply:
    description: Core, PLL and MIPI (1.2V) supply

  vaa-supply:
    description: Analog (2.7V) supply

  port:
    $ref: /schemas/graph.yaml#/$defs/port-base
    unevaluatedProperties: false
    description:
      A single MIPI CSI-2 port with one endpoint connected to the host CSI
      controller.
    properties:
      endpoint:
        $ref: /schemas/media/video-interfaces.yaml#
        unevaluatedProperties: false
        properties:
          bus-type:
            const: 4
          data-lanes:
            minItems: 1
            maxItems: 2
          link-frequencies: true

required:
  - compatible
  - reg
  - clocks
  - clock-names
  - port

additionalProperties: false

examples:
  - |
    #include <dt-bindings/gpio/gpio.h>

    i2c {
        #address-cells = <1>;
        #size-cells = <0>;

        arx3a0: camera@36 {
            compatible = "onnn,arx3a0";
            reg = <0x36>;
            reset-gpios = <&gpio7 7 GPIO_ACTIVE_LOW>;
            power-gpios = <&gpio0 5 GPIO_ACTIVE_HIGH>;
            clocks = <&osc>;
            clock-names = "extclk";
            vdd_io-supply = <&vdd_io>;
            vdd-supply = <&vdd>;
            vaa-supply = <&vaa>;

            port {
                arx3a0_out: endpoint {
                    bus-type = <4>;
                    remote-endpoint = <&csi_ep>;
                    data-lanes = <1 2>;
                    link-frequencies = /bits/ 64 <400000000>;
                };
            };
        };
    };
```

## Documentation/devicetree/bindings/media/snps,dw-mipi-csi2-v150.yaml
```yaml
# SPDX-License-Identifier: (GPL-2.0-only OR BSD-2-Clause)
%YAML 1.2
---
$id: http://devicetree.org/schemas/media/snps,dw-mipi-csi2-v150.yaml#
$schema: http://devicetree.org/meta-schemas/core.yaml#

title: Synopsys DesignWare CSI-2 Host controller (csi2host)

maintainers:
  - Frank Li <Frank.Li@nxp.com>
  - Eugen Hristev <eugen.hristev@microchip.com>

description:
  CSI2HOST is used to receive image coming from an MIPI CSI-2 compatible
  camera. It will convert the incoming CSI-2 stream into a dedicated
  interface called the Synopsys IDI (Image Data Interface).
  This interface is a 32-bit SoC internal only, and can be assimilated
  with a CSI-2 interface.

properties:
  compatible:
    items:
      - enum:
          - fsl,imx93-mipi-csi2
      - const: snps,dw-mipi-csi2-v150

  reg:
    items:
      - description: MIPI CSI-2 core register

  reg-names:
    const: core

  clocks:
    maxItems: 2

  clock-names:
    items:
      - const: per
      - const: pixel

  phys:
    maxItems: 1
    description: MIPI D-PHY

  phy-names:
    const: rx

  resets:
    maxItems: 1

  interrupts:
    maxItems: 1

  power-domains:
    maxItems: 1

  ports:
    $ref: /schemas/graph.yaml#/properties/ports

    properties:
      port@0:
        $ref: /schemas/graph.yaml#/$defs/port-base
        unevaluatedProperties: false
        description:
          Input port node, single endpoint describing the input port.

        properties:
          endpoint:
            $ref: video-interfaces.yaml#
            unevaluatedProperties: false
            description: Endpoint connected to input device

            properties:
              bus-type:
                const: 4

              data-lanes:
                minItems: 1
                maxItems: 4
                items:
                  maximum: 4

              remote-endpoint: true

      port@1:
        $ref: /schemas/graph.yaml#/$defs/port-base
        unevaluatedProperties: false
        description:
          Output port node, single endpoint describing the output port.

        properties:
          endpoint:
            unevaluatedProperties: false
            $ref: video-interfaces.yaml#
            description: Endpoint connected to output device

            properties:
              remote-endpoint: true

    required:
      - port@0
      - port@1

required:
  - compatible
  - reg
  - reg-names
  - interrupts
  - ports

additionalProperties: false

examples:
  - |
    csi@3000 {
        compatible = "fsl,imx93-mipi-csi2", "snps,dw-mipi-csi2-v150";
        reg = <0x03000 0x1000>;
        reg-names = "core";
        phys = <&mipi_dphy_rx 0>;
        phy-names = "rx";
        resets = <&dw_rst 1>;
        interrupts = <2>;

        ports {
            #address-cells = <1>;
            #size-cells = <0>;

            port@0 {
                reg = <0>;

                endpoint {
                    bus-type = <4>; /* MIPI CSI2 D-PHY */
                    remote-endpoint = <&camera_1>;
                    data-lanes = <1 2>;
                };
            };

            port@1 {
                reg = <1>;

                endpoint {
                    remote-endpoint = <&idi_receiver>;
                };
            };
        };
    };

...
```

## Documentation/devicetree/bindings/misc/alif,adc-dac6.yaml
```yaml
# SPDX-License-Identifier: (GPL-2.0 OR BSD-2-Clause)
%YAML 1.2
---
$id: http://devicetree.org/schemas/misc/alif,adc-dac6.yaml#
$schema: http://devicetree.org/meta-schemas/core.yaml#

title: Ensemble ADC_VREF and DAC6 registers init

maintainers:
  - Pankaj Pandey <pankaj.pandey@alifsemi.com>

description: |
  This binding describes a custom node used to initialized the
  ADC_VREF and DAC6 on ensemble devkit platform.

properties:
  compatible:
    const: alif,adc-dac6

  reg:
    maxItems: 1
    description: Memory-mapped register range for the ADC-DAC6 block.

required:
  - compatible
  - reg

additionalProperties: false

examples:
  - |
    adc_dac6: adc-dac6@4902a000 {
      compatible = "alif,adc-dac6";
      reg = <0x4902a000 0x2000>;
    };
```

## Documentation/devicetree/bindings/misc/alif,cmp-module.yaml
```yaml
# SPDX-License-Identifier: (GPL-2.0-only OR BSD-2-Clause)
%YAML 1.2
---
$id: http://devicetree.org/schemas/misc/alif,cmp-module.yaml#
$schema: http://devicetree.org/meta-schemas/core.yaml#

title: ALIF High-Speed Comparator (CMP)

maintainers:
  - Pankaj Pandey <pankaj.pandey@alifsemi.com>

description: |
  The ALIF High-Speed Comparator is an analog comparator with programmable
  reference voltage and hysteresis. This device tree binding defines how it
  should be described in the devicetree.

allOf:
  - if:
      properties:
        compatible:
          contains:
            const: alif,cmp-module
    then:
      required:
        - compatible
        - reg
        - reg-names
        - interrupts
        - interrupt-parent
        - clocks
        - cmp-gpios
        - led-gpios
        - instance
        - status

properties:
  compatible:
    const: alif,cmp-module

  reg:
    maxItems: 1
    description: |
      The module's register space.

  reg-names:
    items:
      - const: cmp_reg

  interrupts:
    maxItems: 1
    description: Interrupt for the comparison module

  clocks:
    maxItems: 1
    description: Clock for the comparison module

  cmp-gpios:
    maxItems: 1
    description: GPIO used for comparison output

  led-gpios:
    maxItems: 1
    description: GPIO for status LED indication required for CMP0, rest will share.

  instance:
    $ref: /schemas/types.yaml#/definitions/uint32
    minimum: 0
    maximum: 3
    description: CMP instance ID (0 = CMP0, 1 = CMP1, etc.)

  status:
    description: Initial module status
    $ref: /schemas/types.yaml#/definitions/string
    enum: [disabled, okay]
    default: disabled

additionalProperties: false

examples:
  - |
    #include <dt-bindings/interrupt-controller/irq.h>
    #include <dt-bindings/interrupt-controller/arm-gic.h>
    #include <dt-bindings/clock/alif,ensemble-clock.h>
    #include <dt-bindings/gpio/gpio.h>

    cmp0: cmp0@49023000 {
        compatible = "alif,cmp-module";
        reg = <0x49023000 0x1000>;
        reg-names = "cmp_reg";
        interrupt-parent = <&gic>;
        interrupts = <GIC_SPI 156 IRQ_TYPE_LEVEL_HIGH>;
        clocks = <&psclks ENSEMBLE_CMP0_CLK>;
        cmp-gpios = <&port15 7 GPIO_ACTIVE_HIGH>;
        led-gpios = <&port13 3 GPIO_ACTIVE_HIGH>;
        instance = <0>;
        status = "disabled";
    };

    cmp1: cmp1@49024000 {
        compatible = "alif,cmp-module";
        reg = <0x49024000 0x1000>;
        reg-names = "cmp_reg";
        interrupt-parent = <&gic>;
        interrupts = <GIC_SPI 157 IRQ_TYPE_LEVEL_HIGH>;
        clocks = <&psclks ENSEMBLE_CMP0_CLK>;
        instance = <1>;
        status = "disabled";
    };
...
```

## Documentation/devicetree/bindings/misc/invensense,ch201.yaml
```yaml
# SPDX-License-Identifier: (GPL-2.0-only OR BSD-2-Clause)
%YAML 1.2
---
$id: http://devicetree.org/schemas/misc/invensense,ch201.yaml#
$schema: http://devicetree.org/meta-schemas/core.yaml#

title: Invensense CH201 Ultrasonic Time-of-Flight Sensor

maintainers:
  - Aravind Krishnan <aravind.krishnan@alifsemi.com>

description: |
  The Invensense CH201 is an ultrasonic time-of-flight sensor that measures
  distance to objects using ultrasonic signals. It communicates via I2C
  and uses GPIO pins for control signals.

  The device exposes a character device interface (/dev/ch201-*) for
  user-space communication with the sensor and for performing control.

properties:
  compatible:
    const: invensense,ch201

  reg:
    maxItems: 1
    description: I2C slave address of the sensor

  reset-gpios:
    maxItems: 1
    description: GPIO pin for sensor reset signal (active low)

  prog-gpios:
    maxItems: 1
    description: GPIO pin for sensor programming mode control

  intr-gpios:
    maxItems: 1
    description: |
      GPIO pin for sensor interrupt output (INT1).
      Used for measurement ready interrupt and RTC calibration pulse.

  interrupts:
    description: |
      Interrupt line from the sensor, typically connected to the INT1 pin.
    maxItems: 1

required:
  - compatible
  - reg
  - interrupts

additionalProperties: false

examples:
  - |
    #include <dt-bindings/interrupt-controller/irq.h>

    i2c {
      #address-cells = <1>;
      #size-cells = <0>;

      ch201@29 {
        compatible = "invensense,ch201";
        reg = <0x29>;
        interrupt-parent = <&port7>;
        interrupts = <3 IRQ_TYPE_EDGE_RISING>;
        reset-gpios = <&gpio 12 1>;      /* GPIO pin 12, active low */
        prog-gpios = <&gpio 13 0>;       /* GPIO pin 13, active high */
        intr-gpios = <&gpio 14 0>;       /* GPIO pin 14, active high */
      };
    };
```

## Documentation/devicetree/bindings/phy/snps,dphy.yaml
```yaml
# SPDX-License-Identifier: (GPL-2.0-only OR BSD-2-Clause)
%YAML 1.2
---
$id: http://devicetree.org/schemas/phy/snps,dphy.yaml#
$schema: http://devicetree.org/meta-schemas/core.yaml#

title: Synopsys DesignWare MIPI D-PHY

maintainers:
  - Yogender Kumar Arya <yogender.kumar@alifsemi.com>

properties:
  compatible:
    oneOf:
      - items:
          - enum:
              - alif,dphy
          - const: snps,dphy
      - const: snps,dphy
      - const: alif,dphy

  reg:
    items:
      - description: SoC configuration registers region
      - description: VBAT register region

  reg-names:
    items:
      - const: soc_regs
      - const: vbat

  clocks:
    minItems: 3
    maxItems: 3

  clock-names:
    items:
      - const: rx_clk
      - const: tx_clk
      - const: pll_ref_clk

  alif,csi-base:
    $ref: /schemas/types.yaml#/definitions/uint32
    description:
      Physical base address of the CSI controller register region shared with
      the D-PHY RX block.

  alif,dsi-base:
    $ref: /schemas/types.yaml#/definitions/uint32
    description:
      Physical base address of the DSI controller register region shared with
      the D-PHY TX block.

  cfg-clk-frequency:
    $ref: /schemas/types.yaml#/definitions/uint32
    description:
      D-PHY configuration clock frequency in Hz. If not present the driver
      uses the rx_clk rate.

  "#phy-cells":
    const: 1

required:
  - compatible
  - reg
  - reg-names
  - clocks
  - clock-names
  - alif,csi-base
  - alif,dsi-base
  - "#phy-cells"

additionalProperties: false

examples:
  - |
    dphy: dphy@1a000000 {
        compatible = "alif,dphy";
        reg = <0x1a000000 0x1000>,
              <0x1a001000 0x1000>;
        reg-names = "soc_regs", "vbat";
        clocks = <&clk_ensemble 103>,
                 <&clk_ensemble 104>,
                 <&clk_ensemble 106>;
        clock-names = "rx_clk", "tx_clk", "pll_ref_clk";
        alif,csi-base = <0x1a002000>;
        alif,dsi-base = <0x1a003000>;
        cfg-clk-frequency = <24000000>;
        #phy-cells = <1>;
    };
```

## Documentation/devicetree/bindings/power/alif,a32-m55-shutdown.yaml
```yaml
# SPDX-License-Identifier: (GPL-2.0-only OR BSD-2-Clause)
%YAML 1.2
---
$id: http://devicetree.org/schemas/power/alif,a32-m55-shutdown.yaml#
$schema: http://devicetree.org/meta-schemas/core.yaml#

title: Alif A32 shutdown mailbox client

maintainers:
  - Pankaj Pandey <pankaj.pandey@alifsemi.com>

description:
  Mailbox client for the request from M55-HE to power off the A32 cluster.
  The channels are the M55-HE MHU0 transmit and receive frames.

properties:
  compatible:
    const: alif,a32-m55-shutdown

  mboxes:
    maxItems: 2

  mbox-names:
    items:
      - const: tx
      - const: rx

required:
  - compatible
  - mboxes
  - mbox-names

additionalProperties: false

examples:
  - |
    a32-m55-shutdown {
        compatible = "alif,a32-m55-shutdown";
        mbox-names = "tx", "rx";
        mboxes = <&mbox_m55_he_mhu0_tx 0 0>,
                 <&mbox_m55_he_mhu0_rx 0 0>;
    };
```
